#include "Adafruit_NeoPixel.h"
#include <Wire.h>
#include <EEPROM.h>

Adafruit_NeoPixel strip{
  40,
  13, //Pin
  NEO_BRG
};

const PROGMEM byte wand[] = {0x00, 0x00, 0x00, 0x00, 0x00, 0x00, 0x00, 0x00, 0x00, 0x00, 0x00, 0x00, 0xFF,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 0xF9, 0xF4};
const PROGMEM byte pfeilLinks[] = {0xFF, 0xE5, 0x00, 0xFF, 0xE5, 0x00, 0xFF, 0xE5, 0x00, 0x00, 0x00, 0x00, 0x00,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 0x00, 0x00};
const PROGMEM byte pfeilRechts[] = {0x00, 0x00, 0x00, 0x00, 0x00, 0x00, 0x00, 0x00, 0x00, 0x00, 0x00, 0x00, 0xFF,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 0x00, 0x00};
const PROGMEM byte blinkerBlau[] = {0x00, 0x00, 0x00, 0x00, 0x00, 0x00, 0x00, 0x00, 0x00, 0x00, 0x00, 0x00, 0x00,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 0x00, 0x00};
const PROGMEM byte blinkerGelb[] = {0x00, 0x00, 0x00, 0x00, 0x00, 0x00, 0x00, 0x00, 0x00, 0x00, 0x00, 0x00, 0xFF,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 0x00, 0x00};
const PROGMEM byte mannGruen[] = {0x00, 0x7E, 0x0D, 0x00, 0x06, 0x00, 0x00, 0x00, 0x00, 0x00, 0x79, 0x0D, 0x00,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 0x00, 0x00};
const PROGMEM byte mannRot[] = {0xFC, 0x00, 0x00, 0x02, 0x00, 0x00, 0xFC, 0x00, 0x00, 0x00, 0x00, 0x00, 0x00,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 0x00, 0x00};
const PROGMEM byte ampel[] = {0x00, 0x00, 0x00, 0x00, 0x00, 0x00, 0x00, 0x00, 0x00, 0x00, 0x00, 0x00, 0x00,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 0x00, 0x00};

byte* animPtr = nullptr;
enum {ProgMem, RAM} animPtrRegion;
size_t animLength;
size_t picIdx;

template <size_t N>
void switchToAnim(const byte (&anim)[N]) {
  if (animPtrRegion == RAM)
    delete[] animPtr;
  animPtr = const_cast<byte*>(anim); //wird nie verändert, Compiler kann das aber nicht garantieren
  animPtrRegion = ProgMem;
  animLength = N / (40 * 3);
  picIdx = 0;
}

template <typename T>
void loadAnimFromReader(T&& reader) {
  animLength = size_t(reader.nextByte()) << 8 + reader.nextByte();
  size_t byteLength = animLength * 40 * 3;
  animPtr = new byte[byteLength];
  animPtrRegion = RAM;
  for (size_t idx = 0; idx < byteLength; ++idx)
    animPtr[idx] = reader.nextByte();
}

struct MegaReader {
  unsigned int flashIdx;
  MegaReader() : flashIdx{0} { }
  byte nextByte() {
    byte result = Wire.read();
    EEPROM.update(flashIdx, result);
    ++flashIdx;
    return result;
  }
};

struct FlashReader {
  unsigned int idx;
  FlashReader() : idx{0} { }
  byte nextByte() {
    byte result = EEPROM.read(idx);
    ++idx;
    return result;
  }
};

void setup() {
  Wire.begin(0); //Mega sollte sich mit Slave-Adresse 0 verbinden.
  strip.begin();
  strip.setBrightness(0x30);
}

void loop() {
  //auf Animationswechsel pruefen
  if (Wire.available())
  {
    switch (Wire.read())
    {
      case 0:
        animPtr = nullptr;
        break;
      case 1:
        switchToAnim(wand);
        break;
      case 2:
        switchToAnim(pfeilLinks);
        break;
      case 3:
        switchToAnim(pfeilRechts);
        break;
      case 4:
        switchToAnim(blinkerBlau);
        break;
      case 5:
        switchToAnim(blinkerGelb);
        break;
      case 6:
        switchToAnim(mannGruen);
        break;
      case 7:
        switchToAnim(mannRot);
        break;
      case 8:
        switchToAnim(ampel);
        break;
      case 0xFE:
        //benutzerdefinierte Animation vom EEPROM einlesen
        loadAnimFromReader(FlashReader());
        break;
      case 0xFF:
        //erstmal LEDs ausschalten, würden sonst im Bild stehen bleiben
        strip.fill(0x00);
        strip.show();
        //benutzerdefinierte Animation vom Smartphone einlesen
        loadAnimFromReader(MegaReader());
        break;
    }
  }
  //aktuelles Bild auf strip darstellen
  if (animPtr == nullptr)
    strip.fill(0x00);
  else {
    const byte* picPtr = animPtr + picIdx * 40 * 3;
    for (size_t pix = 0; pix < 40; ++pix) {
      const byte* pixPtr = picPtr + 3 * pix;
      byte r, g, b;
      if (animPtrRegion == ProgMem) {
        r = pgm_read_byte_near(pixPtr + 0);
        b = pgm_read_byte_near(pixPtr + 1);
        g = pgm_read_byte_near(pixPtr + 2);
      }
      else if (animPtrRegion == RAM) {
        r = pixPtr[0];
        g = pixPtr[1];
        b = pixPtr[2];
      }
      strip.setPixelColor(pix, r, g, b);
    }
  }
  strip.show();
  //200ms warten
  delay(200);
  //naechstes Bild auswaehlen
  ++picIdx;
  if (picIdx == animLength)
    picIdx = 0;
}
